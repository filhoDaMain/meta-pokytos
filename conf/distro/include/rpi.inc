## conf/distro/include/rpi.inc
```bitbake
# Raspberry common configurations
unset VC4DTBO
RPI_USE_U_BOOT = "1"
ENABLE_UART = "1"

unset MACHINE_EXTRA_RRECOMMENDS
MACHINE_EXTRA_RRECOMMENDS = "\
    kernel-modules \
    brcm-firmware \
    kernel-module-display7 \
"
```

## conf/distro/pokytos.conf
```bitbake
DISTRO = "pokytos"
DISTRO_NAME = "Pokytos - A small embedded distro"
DISTRO_VERSION = "1.0.0"
MAINTAINER = "Andre Temprilho (filhoDaMain)"

# Removes default appends to TMPDIR
TCLIBCAPPEND = ""
BBMULTICONFIG = "developer"

SDK_VENDOR = "-pokytossdk"
SDK_VERSION = "${@d.getVar('DISTRO_VERSION').replace('snapshot-${METADATA_REVISION}', 'snapshot')}"
SDK_VERSION[vardepvalue] = "${SDK_VERSION}"

PACKAGE_CLASSES = "package_ipk"
INIT_MANAGER = "systemd"
```
