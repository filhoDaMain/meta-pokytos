## conf/distro/include/raspberrypi3.inc
```bitbake
# Raspberry PI 3 machine specific includes
RPI_USE_U_BOOT = "1"
LICENSE_FLAGS_ACCEPTED = "synaptics-killswitch"

DEBUG_BUILD:raspberrypi3:kerneldebug = "1"
```

## conf/layer.conf
```bitbake
# meta-pokytos layer configuration file

# We have a conf and classes directory, add to BBPATH
BBPATH .= ":${LAYERDIR}"

# We have recipes-* directories, add to BBFILES
BBFILES += "${LAYERDIR}/recipes-*/*/*.bb \
            ${LAYERDIR}/recipes-*/*/*.bbappend"

BBFILE_COLLECTIONS += "meta-pokytos"
BBFILE_PATTERN_meta-pokytos = "^${LAYERDIR}/"
BBFILE_PRIORITY_meta-pokytos = "5"
LAYERSERIES_COMPAT_meta-pokytos = "nanbield"
```
